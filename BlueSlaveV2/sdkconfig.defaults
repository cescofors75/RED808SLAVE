## SlavePico/sdkconfig.defaults
```kconfig
CONFIG_ARDUHAL_LOG_DEFAULT_LEVEL=3
CONFIG_LWIP_MAX_SOCKETS=8
CONFIG_FREERTOS_HZ=1000
CONFIG_ESP_COREDUMP_ENABLE_TO_NONE=y
CONFIG_ESP_COREDUMP_ENABLE=n
CONFIG_ESP_WIFI_REMOTE_ENABLED=n
CONFIG_ESP_HOSTED_ENABLE_BT_NIMBLE=n
```
